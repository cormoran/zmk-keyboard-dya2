## boards/shields/dya2/Kconfig.defconfig
```kconfig
if SHIELD_DYA2_RIGHT

config ZMK_KEYBOARD_NAME
    default "DYA2"

config ZMK_SPLIT_ROLE_CENTRAL
    default y
endif

if SHIELD_DYA2_LEFT || SHIELD_DYA2_RIGHT
config ZMK_SPLIT
    default y

config ZMK_KSCAN_CHARLIEPLEX_WAIT_BEFORE_INPUTS
    default 20
endif
```
